## ESP32-C3/sdkconfig.defaults
```kconfig
# Flash size for XIAO ESP32C3
CONFIG_ESPTOOLPY_FLASHSIZE_2MB=y
CONFIG_ESPTOOLPY_FLASHSIZE="2MB"

# Size optimization
CONFIG_COMPILER_OPTIMIZATION_SIZE=y

# Enable runtime-visible app logs
CONFIG_LOG_DEFAULT_LEVEL_INFO=y
CONFIG_LOG_MAXIMUM_LEVEL_INFO=y
CONFIG_BOOTLOADER_LOG_LEVEL_INFO=y

# Route console logs to USB Serial/JTAG (instead of UART0)
# CONFIG_ESP_CONSOLE_UART_DEFAULT is not set
CONFIG_ESP_CONSOLE_USB_SERIAL_JTAG=y
# CONFIG_ESP_CONSOLE_UART_CUSTOM is not set
# CONFIG_ESP_CONSOLE_NONE is not set
CONFIG_ESP_CONSOLE_SECONDARY_NONE=y
```

## sdkconfig.defaults
```kconfig
# Flash size for XIAO ESP32C3
CONFIG_ESPTOOLPY_FLASHSIZE_2MB=y
CONFIG_ESPTOOLPY_FLASHSIZE="2MB"
```
